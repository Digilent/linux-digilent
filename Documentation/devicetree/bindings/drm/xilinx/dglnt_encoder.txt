## Documentation/devicetree/bindings/drm/xilinx/dglnt_encoder.txt
```
Device-Tree bindings for Digilent DRM Encoder Slave

This driver provides support for VGA and HDMI outputs on Digilent FPGA boards. The
VGA or HDMI port must be connected to a Xilinx display pipeline via an axi2vid
IP core.

Required properties:
 - compatible: Should be "dglnt,drm-encoder".

Optional properties:
 - dglnt,edid-i2c: The I2C device connected to the DDC bus on the video connector.
                   This is used to obtain the supported resolutions of an attached 
                   monitor. If not defined, then a default set of resolutions is used
                   and the display will initialize to 720p. Note most VGA connectors
                   on Digilent boards do not have the DDC bus routed out. 

Example:

      encoder_0: digilent_encoder {
		   compatible = "dglnt,drm-encoder";
         dglnt,edid-i2c = <&i2c1>;
      };
```

## Documentation/devicetree/bindings/drm/xilinx/digilent_encoder.txt
```
Device-Tree bindings for Digilent DRM Encoder Slave

This driver provides support for VGA and HDMI outputs on Digilent FPGA boards. The
VGA or HDMI port must be connected to a Xilinx display pipeline via an axi2vid
IP core.

Required properties:
 - compatible: Should be "digilent,drm-encoder".

Optional properties:
 - digilent,edid-i2c: The I2C device connected to the DDC bus on the video connector.
                      This is used to obtain the supported resolutions of an attached 
                      monitor. If not defined, then a default set of resolutions is used
                      and the display will initialize to the closest available size 
                      specified by vpref and hpref. Note most VGA connectors on Digilent 
                      boards do not have the DDC bus routed out. 
- digilent,fmax: The maximum pixel clock frequency allowed, in KHz (as integer). Should 
                 be set considering maximum serdes rate and also the rate the axi stream
                 mm2s bus on the vdma is clocked. If pixel clock is greater than the mm2s
                 stream clock then the output pipeline will underflow. Default is 150000.
- digilent,hmax: The maximum horizontal width allowed for resolutions (as integer). 
                 Default is 1920. 
- digilent,vmax: The maximum vertical height allowed for resolutions (as integer). 
                 Default is 1080.
- digilent,hpref: The preferred resolution width (as integer). Only used if edid-i2c not
                  present or invalid. Can be used to control resolution at boot when no 
                  EDID bus is available. Default is 1280.
- digilent,vpref: The preferred resolution height (as integer). Only used if edid-i2c not
                  present or invalid. Can be used to control resolution at boot when no 
                  EDID bus is available. Default is 720.

Example:

      encoder_0: digilent_encoder {
		   compatible = "digilent,drm-encoder";
         digilent,edid-i2c = <&i2c1>;
      };
```

## Documentation/devicetree/bindings/i2c/xiic.txt
```
Xilinx IIC controller:

Required properties:
- compatible : Must be "xlnx,xps-iic-2.00.a"
- reg : IIC Register location and length
- interrupts : IIC Interrupt
- #address-cells = <1>
- #size-cells = <0>

Optional properties:
- Child nodes conforming to i2c bus binding

Example:

	axi_iic_0: i2c@40800000 {
		compatible = "xlnx,axi-iic-1.01.b" "xlnx,xps-iic-2.00.a";
		interrupts = < 1 2 >;
		reg = < 0x40800000 0x10000 >;

		#size-cells = <0>;
		#address-cells = <1>;
	};
```

## Documentation/devicetree/bindings/sound/digilent,zybo-sm603.txt
```
Digilent ZYBO AXI-I2S SSM2603 CPU DAI bindings

Note: The card is initially designed for ZYBO linux_bd design which use I2S
      and external SSM2603 codec. The SSM2603 is driven by a fixed clock of
      12.288MHz which does not have 44.1KHz sampling rate support.

Required properties:
	- compatible	: Must be "digilent,zybo-sound"
	- audio-code	: A phandle reference to a audio codec
	- cpu-dai	: A phandle reference to a CPU DAI controller

Example:

	zybo_ssm2603_snd: zybo_ssm2603_snd {
		compatible = "digilent,zybo-sound";
		audio-codec = <&ssm2603>;
		cpu-dai = <&axi_i2s_adi_0>;
	};
```

## drivers/gpu/drm/analog/Kconfig
```kconfig
config DRM_ANALOG
	tristate "DRM Support for Samsung SoC ANALOG Series"
	depends on DRM && PLAT_SAMSUNG
	default	n
	select DRM_KMS_HELPER
	select FB_CFB_FILLRECT
	select FB_CFB_COPYAREA
	select FB_CFB_IMAGEBLIT
	select VT_HW_CONSOLE_BINDING if FRAMEBUFFER_CONSOLE
	help
	  Choose this option if you have a Samsung SoC ANALOG chipset.
	  If M is selected the module will be called analogdrm.

config DRM_ANALOG_FIMD
	tristate "Exynos DRM FIMD"
	depends on DRM_ANALOG
	default n
	help
	  Choose this option if you want to use Exynos FIMD for DRM.
	  If M is selected, the module will be called analog_drm_fimd
```

## drivers/staging/xlnx_axidma/Kconfig
```kconfig
config XLNX_AXI_DMA
	tristate "Xilinx Axi DMA high level driver"
	depends on CMA && DMA_CMA && XILINX_DMA && DMA_SHARED_BUFFER

	help
	  This module adds support to an additional layer to the XILINX
	  DMA driver. The purpose of this software stack is to allow userspace
	  Linux applications to interact with hardware on the FPGA fabric.
	  Additonally it enables zero-copy capabilites.
```

## sound/soc/xlnx/Kconfig
```kconfig
config SND_SOC_XILINX
	tristate "SoC Audio for Xilinx based boards"
	depends on SND_SOC && (MICROBLAZE || ARCH_ZYNQ)
	select SND_SOC_DMAENGINE_PCM

config SND_SOC_AXI_SPDIF
	tristate

config SND_SOC_ADV7511_HDMI
	tristate "ADV7511 HDMI transmitter sound support"
	depends on SND_SOC_XILINX
	select SND_SOC_AXI_SPDIF

config SND_SOC_ZED_ADAU1761
	tristate "ZED board sound support"
	depends on SND_SOC_XILINX
	select SND_SOC_AXI_I2S
	select SND_SOC_ADAU1761
```
